## arch/Kconfig
```kconfig
config ARCH_ARM
   bool

rsource "arm/Kconfig"

rsource "arm64/Kconfig"

config ARCH_CSKY
   bool

config ARCH_RISCV
   bool

config ARCH_RISCV32
   bool
   select ARCH_RISCV

config ARCH_CACHE
    bool "Enable arch cache maintenance API (ArchICache*/ArchDCache*)"
    depends on ARCH_RISCV
    default n
    help
      Build in the RISC-V I/D-cache maintenance interface (arch/cache.h) and
      its open-source per-core implementation (e.g. ws63 builds
      arch/risc-v/src/linx131/los_cache.c for LinxCore131). Each board that
      turns this on must supply a cache implementation matching its ABI and
      core CSR space (e.g. ws63 builds los_cache.c for the LinxCore131 custom
      CSR space 0x7C0..0x7C7; DiTing/3322 needs its own implementation for
      Linx-M with ilp32d). Boards without a cache provider must leave this
      off so the ArchICache*/ArchDCache* symbols are not referenced.

config ARCH_RISCV_HW_ATOMIC
    bool "RISC-V hardware Atomic (A) extension is available"
    depends on ARCH_RISCV
    default n
    help
      Select this if the RISC-V core implements the standard Atomic (A)
      extension in hardware (lr.w/sc.w/amoadd.w/amoswap.w ...). When
      selected, the arch atomic operations use A-extension instructions;
      otherwise they fall back to interrupt-lock (LOS_IntLock) based
      atomics, which is correct for single-core but disables interrupts
      during each operation.

config ARCH_XTENSA
   bool

rsource "risc-v/Kconfig"

comment "Extra Configurations"

config ARCH_FPU_DISABLE
    bool "Disable Floating Pointer Unit"
    default n
    help
      This option will bypass floating procedure in system.

config ARCH_FPU_DOUBLE
    bool "Enable Double Precision FPU (D extension)"
    default n
    depends on !ARCH_FPU_DISABLE
    help
      Save/restore FP registers as 64-bit slots (fld/fsd, FPUREGBYTES=8) and
      build with the D extension under the hard-float ilp32d ABI. The board config.gni must
      use -march with the d extension and -mabi=ilp32d when this is set.

config ARCH_UNALIGNED_EXC
    bool "Enable Unaligned Exception"
    default y
    depends on ARCH_ARM
    help
     This option will enable unaligned exception.

config EXC_SIMPLE_INFO
    bool "Enable Exception Simple Info"
    default n
    help
      This option is used to reduce exc output info.

config ARCH_TIMER_VENDOR
    bool "Use vendor-provided timer instead of arch default"
    default n
    help
      Select this if the board has a custom timer (not SiFive CLINT).
      The board must provide its own ArchSysTickTimerGet() and ArchEnterSleep().
```

## arch/risc-v/Kconfig
```kconfig
# RISC-V Architecture
# Only LinxCore131 (ws63) and LinxCore170 (3322) cores are adapted here.
# Note: config names omit the LOSCFG_ prefix; genconfig adds it automatically,
# so GN checks use defined(LOSCFG_ARCH_LINXCORE_131) etc.

config ARCH_RISCV_RV32IMC
    bool
    help
      32-bit RISCV RV32IMC base ISA.

config ARCH_RISCV_ISA_F
    bool
    help
      "F" Standard Extension for Single-Precision Floating-Point.

config ARCH_RISCV_ISA_D
    bool
    select ARCH_RISCV_ISA_F
    help
      "D" Standard Extension for Double-Precision Floating-Point.

config LCMP_CUSTOM_INST16_EXTENSIONS
    bool
    help
      Extra custom 16-bit extension for RISC-V C-extension. Depends on ARCH_LINX_M.
      Includes arithmetic logic, byte/half-word sign/zero-extension, store-zero, push/pop.

config LCMP_CUSTOM_INST16_SUB_EXTENSIONS
    bool
    help
      Another custom 16-bit extension. Has encoding conflicts with standard C-extension.
      Cannot be enabled when C-extension and D-extension are both configured.

config LCMP_CUSTOM_INST32_EXTENSIONS
    bool
    help
      32-bit custom instructions for code size and performance optimization.
      Includes pre-shift ALU, immediate compare-branch, bit manipulation,
      load/store multiple, conditional move, half-precision FP convert,
      pre/post-index load/store, load/store pair, FP round-to-int,
      interrupt nest enable/disable, large-offset jump, gp-based load/store,
      multiply-add/sub, prefetch, stop-for-security.

config LCMP_CUSTOM_INST48_EXTENSIONS
    bool
    help
      48-bit custom extension that reduces cost of encoding large immediates, saving two bytes.

config ARCH_LINX_M
    bool
    select ARCH_RISCV_RV32IMC
    select ARCH_RISCV32
    select RISCV_LCMP_CLIC if !ARCH_INTERRUPT_VENDOR
    help
      General setup for LinxCore m-profile. Specific processor cores select this
      option directly.

# Supported Processor Cores

config ARCH_QEMU_RISCV32_VIRT
    bool
    select ARCH_RISCV_RV32IMC
    select ARCH_RISCV32
    help
      QEMU virt platform RISC-V 32-bit (rv32imac). Uses the standard
      RISC-V CLINT timer and memory-mapped PLIC. No custom instructions.

config ARCH_LINXCORE_131
    bool
    select ARCH_RISCV_RV32IMC
    select ARCH_RISCV32
    select RISCV_HIMIDEERV200_PLIC if !ARCH_INTERRUPT_VENDOR
    help
      HiSilicon LinxCore131 (ws63). Does not belong to LinxCore m-profile,
      so does not select ARCH_LINX_M.

config ARCH_LINXCORE_170
    bool
    select ARCH_LINX_M

config ARCH_RISCV_EPMP
    bool
    help
      RISC-V PMP enhancements extension.

config ARCH_RISCV_TES
    bool
    select ARCH_RISCV_EPMP
    help
      RISC-V Trusted Execution State Extension.

config ARCH_RISCV_INT_AUTO_STACK
    bool
    help
      RISC-V interrupt hardware stacking.

# ---------------------------------------------------------------------------
# Reset vector provider
# ---------------------------------------------------------------------------
config USING_BOARD_RESET_VECTOR
    bool "Board provides its own reset_vector.S and stack layout"
    default y
    help
      When set, the board supplies its own reset_vector.S and linker-defined
      stack symbols; the arch-level los_reset_vector.S / los_stack.S are
      excluded to avoid duplication. Clear for a bare board.

# ---------------------------------------------------------------------------
# System stack sizes (used by los_stack.S when USING_BOARD_RESET_VECTOR is off)
# ---------------------------------------------------------------------------
config IRQ_STACK_SIZE
    int "IRQ stack size in bytes"
    default 2048

config STARTUP_STACK_SIZE
    int "Startup stack size in bytes (0 = reuse IRQ stack)"
    default 2048

config EXC_STACK_SIZE
    int "Exception stack size in bytes (0 = reuse startup stack)"
    default 1024

config NMI_STACK_SIZE
    int "NMI stack size in bytes (0 = reuse exc stack)"
    default 1024

# LinxCore170 configuration variants
config ARCH_LINXCORE_170_CONFIG61
    bool
    select ARCH_LINX_M
    select ARCH_RISCV_ISA_D
    select LCMP_CUSTOM_INST16_EXTENSIONS
    select LCMP_CUSTOM_INST32_EXTENSIONS
    select ARCH_RISCV_TES

config ARCH_LINXCORE_170_CONFIG41
    bool
    select ARCH_LINX_M
    select ARCH_RISCV_ISA_D
    select LCMP_CUSTOM_INST16_EXTENSIONS
    select LCMP_CUSTOM_INST32_EXTENSIONS

config ARCH_LINXCORE_170_CONFIG32
    bool
    select ARCH_LINX_M
    select ARCH_RISCV_ISA_F
    select LCMP_CUSTOM_INST16_EXTENSIONS
    select LCMP_CUSTOM_INST32_EXTENSIONS

config ARCH_LINXCORE_170_CONFIG60
    bool
    select ARCH_LINX_M
    select ARCH_RISCV_ISA_D
    select LCMP_CUSTOM_INST16_EXTENSIONS
    select LCMP_CUSTOM_INST32_EXTENSIONS
    select ARCH_RISCV_EPMP
```

## components/embedded_smart/agent/Kconfig
```kconfig
mainmenu "LiteCrab Configuration"

config LITECRAB_PRODUCT_ID
    string "Product identifier"

choice LITECRAB_PLATFORM
    prompt "Target platform"
config LITECRAB_PLATFORM_POSIX
    bool "POSIX host"
config LITECRAB_PLATFORM_HI3516
    bool "Hi3516 embedded platform"
endchoice

choice LITECRAB_ARTIFACT
    prompt "Artifact type"
config LITECRAB_ARTIFACT_EXECUTABLE
    bool "Standalone executable"
config LITECRAB_ARTIFACT_STATIC_LIBRARY
    bool "Embedded static library"
endchoice

config LITECRAB_CAP_OBSERVABILITY
    bool "Observability"
    default n

config LITECRAB_CAP_MEMORY
    bool "Memory"
    default n

config LITECRAB_CAP_SKILLS
    bool "Skills"
    default n

config LITECRAB_CAP_WORKSPACE_TOOLS
    bool "Workspace tools"
    default n

config LITECRAB_CAP_PROCESS_TOOLS
    bool "Process tools"
    default n

config LITECRAB_CAP_TCP_GATEWAY
    bool "TCP Gateway"
    default n

config LITECRAB_CAP_ALARM
    bool "Alarm ingress"
    default n

config LITECRAB_CAP_MCP_CLIENT
    bool "MCP client"
    default n

config LITECRAB_CAP_EMBEDDED_AGENT_API
    bool "Embedded Agent API"
    default n

config LITECRAB_CAP_ROBOT_TOOLS
    bool "Robot tools"
    default n

config LITECRAB_CAP_TTS_OUTPUT
    bool "TTS output"
    default n
```

## components/embedded_smart/agent/defconfigs/energy_inspection.defconfig
```kconfig
CONFIG_LITECRAB_PRODUCT_ID="energy_inspection"
CONFIG_LITECRAB_PLATFORM_POSIX=y
CONFIG_LITECRAB_ARTIFACT_EXECUTABLE=y
CONFIG_LITECRAB_CAP_OBSERVABILITY=y
CONFIG_LITECRAB_CAP_MEMORY=y
CONFIG_LITECRAB_CAP_SKILLS=y
CONFIG_LITECRAB_CAP_WORKSPACE_TOOLS=y
# CONFIG_LITECRAB_CAP_PROCESS_TOOLS is not set
CONFIG_LITECRAB_CAP_TCP_GATEWAY=y
# CONFIG_LITECRAB_CAP_ALARM is not set
CONFIG_LITECRAB_CAP_MCP_CLIENT=y
# CONFIG_LITECRAB_CAP_EMBEDDED_AGENT_API is not set
# CONFIG_LITECRAB_CAP_ROBOT_TOOLS is not set
# CONFIG_LITECRAB_CAP_TTS_OUTPUT is not set
```

## components/embedded_smart/applications/agent_test/agent/defconfigs/robot_hi3516.defconfig
```kconfig
CONFIG_LITECRAB_PRODUCT_ID="robot_hi3516"
CONFIG_LITECRAB_PLATFORM_HI3516=y
CONFIG_LITECRAB_ARTIFACT_STATIC_LIBRARY=y
CONFIG_LITECRAB_CAP_OBSERVABILITY=y
CONFIG_LITECRAB_CAP_MEMORY=y
# CONFIG_LITECRAB_CAP_SKILLS is not set
# CONFIG_LITECRAB_CAP_WORKSPACE_TOOLS is not set
# CONFIG_LITECRAB_CAP_PROCESS_TOOLS is not set
# CONFIG_LITECRAB_CAP_TCP_GATEWAY is not set
# CONFIG_LITECRAB_CAP_ALARM is not set
# CONFIG_LITECRAB_CAP_MCP_CLIENT is not set
CONFIG_LITECRAB_CAP_EMBEDDED_AGENT_API=y
CONFIG_LITECRAB_CAP_ROBOT_TOOLS=y
CONFIG_LITECRAB_CAP_TTS_OUTPUT=y
```

## kernel/extended/signal/Kconfig
```kconfig
config KERNEL_SIGNAL
    bool "Enable Signal"
    default n if KERNEL_RAM_PRESET_TINY || KERNEL_RAM_PRESET_SMALL
    default y
    depends on KERNEL_EXTKERNEL && ARCH_ARM_CORTEX_M
    help
      Select y to build LiteOS with signal.
```
