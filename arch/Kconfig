## targets/rk3568_m/liteos_m/Kconfig
```kconfig
#
# RK3568 AMP board options (sourced via $(DEVICE_PATH)/Kconfig).

config RK3568_OPENAMP
    bool "Enable OpenAMP/rpmsg (MICA) support"
    default n
    depends on PLATFORM_RK3568_M
    select COMPONENT_OPENAMP
    help
      Bring up open-amp + libmetal on the RTOS side and register the
      rpmsg-tty endpoint for the Linux MICA framework (/dev/ttyRPMSG0).
      Interrupt notification uses SGI 7 (MICA convention).

config MCS
    bool "Enable MCS hybrid deployment (AMP slave alongside Linux master)"
    default n
    depends on PLATFORM_RK3568_M
    select RK3568_OPENAMP
    help
      MCS hybrid deployment: this core runs as the AMP slave started and
      stopped by the Linux master mcs_km driver, sharing the debug UART
      (Linux ttyFIQ0 console) with the master. When enabled:
        - UartInit keeps the shared UART untouched (polled TX only);
        - the shell does not poll UART RX (input comes over rpmsg tty);
        - the mica/rpmsg service task is created at boot.
      When disabled the board owns the UART itself (standalone bring-up).

config MCS_NET
    bool "Real-time NIC data plane on GMAC1 (slave side)"
    default n
    depends on MCS
    help
      Slave-side data plane for the real-time NIC endpoint: the Linux
      master mcs_net.ko gives up eth1 (GMAC1, fe010000) after bring-up
      (clocks, reset, pinmux/GRF, PHY/MDIO) and this core runs the RX/TX
      rings against the frozen net.h contract (protocol-agnostic frame
      driver; any link-layer protocol is implemented on top). The GMAC1
      interrupt (INTID 64) is owned by this core and registered via
      ArchHwiCreate. Rx/Tx mode (interrupt / polled / hybrid) is a
      runtime NetConfig option, not a build switch. A user demo task
      (net_test.c) is compiled in: forced 100M full-duplex + polled
      RX, sending numbered 0x88B5 test frames and printing statistics
      once a second (see the NIC user guide).

config MCS_CAN
    bool "Real-time CAN data plane on CAN1 (slave side)"
    default n
    depends on MCS
    help
      Slave-side data plane for the real-time CAN endpoints: the Linux
      master mcs_can.ko performs the hand-over before this core touches
      the hardware (baudclk retarget to 100MHz + clock hold, CRU reset
      pulse, can1m1 pinmux) and this core runs the classic CAN 2.0B data
      path against the protocol-agnostic can.h contract (rx mode, work
      mode and bit timing are runtime CanConfig options, not build
      switches). There is no runtime handshake with the master - the ko
      must simply be loaded first (see board/DRIVER_GUIDE.md). A user demo task
      (can_test.c) is compiled in: internal loopback phases
      (irq/poll rx, 125k/250k/500k/1M bit timing, ext-id/rtr/dlc sweep)
      printing statistics once a second (see the CAN user guide).

config RK3568_UART
    bool "Enable the RK3568 UART driver (Modbus-RTU oriented, uart_drv.h API)"
    default n
    depends on PLATFORM_RK3568_M
    depends on PLATFORM_HWI_WITH_ARG
    help 
      Interrupt-driven DW 8250 UART driver for UART1~UART9 (board/uart.c,
      API in include/uart_drv.h): per-port RX/TX ring buffers + semaphore
      blocking semantics, line-synchronous write (LSR TEMT anchored),
      CRU/GRF/GIC profile bring-up, and the uart_test shell command.
      Independent of the console driver (uart_porting.c): the protocol
      layer passes a port id (1..9) and gets it initialized - UART2 is
      shared with the Linux master console, caller-owned risk (§4.2).
      RS485 direction control is out of scope (auto-direction
      transceiver); the optional RX echo suppression is a profile flag.

config MCS_RPC
    bool "mica rpc service + socket proxy demo (slave side)"
    default n
    depends on MCS
    help
      mica service-framework probe plus the socket proxy data path: the
      rpmsg-rpc endpoint is brought up by libmica (rpc_service.c, both
      client and server roles) and this core registers an RPC_PING echo
      handler so the master can verify the slave service framework. On
      top of the rpc channel the np_* socket proxy API (libmica
      net_service.c, demo in netproxy_test.c) forwards BSD socket calls
      (socket/bind/listen/accept/connect/send/recv/sendto/recvfrom/
      setsockopt/getsockopt/getsockname/getpeername/shutdown/select/
      close) to the master netproxy worker, which executes them on the
      Linux network stack (socket RPC proxy mode, the UniProton proxy
      model). The pfs_* proxy filesystem API (libmica fs_service.c)
      forwards file calls (open/read/write/lseek/fcntl/unlink/stat/
      fstat/rename/remove/mkdir/rmdir/chdir/getcwd/access/getdents) to
      the master filesystem, and np_system runs a shell command on the
      master console. Shell commands: rpctest [len] runs a client
      round-trip through the master; nptest <ip> [port] runs a UDP and
      a TCP probe against <ip>; fstest/systest exercise the proxy
      filesystem and the proxy shell.

config MCS_TIMER
    bool "Shared-free SoC timer data plane on TIMER1 (slave side)"
    default n
    depends on MCS
    help
      Slave-side timer driver for the SoC TIMER block. The master oh
      kernel owns TIMER0 (fe5f0000, its clockevent per the dtb
      timer@fe5f0000 node), so this driver binds TIMER1 (fe5f0020,
      24MHz) - a channel the master never touches: it enables the
      CRU clock gate itself and never pulses the block-wide
      SRST_P_TIMER reset. Data plane against the protocol-agnostic
      timer.h contract: oneshot/periodic work mode, irq-only expiry
      (minimal set; poll mode trimmed, add later if a caller needs it),
      runtime interval change (TimerSetInterval) and a self-test demo
      task (timer_test.c) with phase-driven checks (count + tick-span
      accuracy, oneshot single-fire, rearm-on-the-fly). The slave
      tick itself stays on the ARM generic timer and is untouched.
```

## targets/rk3588_m/liteos_m/Kconfig
```kconfig
#
# RK3588 AMP board options (sourced via $(DEVICE_PATH)/Kconfig).
#

config RK3588_OPENAMP
    bool "Enable OpenAMP/rpmsg (MICA) support"
    default n
    depends on PLATFORM_RK3588_M
    select COMPONENT_OPENAMP
    help
      Bring up open-amp + libmetal on the RTOS side and register the
      rpmsg-tty endpoint for the Linux MICA framework (/dev/ttyRPMSG0).
      Interrupt notification uses SGI 7 (MICA convention).

config MCS
    bool "Enable MCS hybrid deployment (AMP slave alongside Linux master)"
    default n
    depends on PLATFORM_RK3588_M
    select RK3588_OPENAMP
    help
      MCS hybrid deployment: this core (CPU7, Cortex-A76) runs as the AMP
      slave started and stopped by the Linux master mcs_km driver, sharing
      the debug UART (Linux ttyFIQ0 console) with the master. When enabled:
        - UartInit keeps the shared UART untouched (polled TX only);
        - the shell does not poll UART RX (input comes over rpmsg tty);
        - the mica/rpmsg service task is created at boot.
      When disabled the board owns the UART itself (standalone bring-up).

config RK3588_UART
    bool "Enable the RK3588 UART driver (Modbus-RTU oriented, uart_drv.h API)"
    default n
    depends on PLATFORM_RK3588_M
    depends on PLATFORM_HWI_WITH_ARG
    help
      Interrupt-driven DW 8250 UART driver for UART1~UART9 (board/uart.c,
      API in include/uart_drv.h): per-port RX/TX ring buffers + semaphore
      blocking semantics, line-synchronous write (LSR TEMT anchored),
      CRU/IOC/GIC profile bring-up, and the uart_test shell command.
      Independent of the console driver (uart_porting.c): the protocol
      layer passes a port id (1..9) and gets it initialized - UART2 is
      shared with the Linux master console, caller-owned risk.
      RS485 direction control is out of scope (auto-direction
      transceiver); the optional RX echo suppression is a profile flag.

# Real-time data-plane options (MCS_NET / MCS_CAN) live with the board
# sources one level down; rsource is relative to this file (this file is
# reached as $(DEVICE_PATH)/Kconfig through the board symlink).
rsource "board/Kconfig"
```

## targets/rk3588_m/liteos_m/board/Kconfig
```kconfig
#
# RK3588 AMP board options (sourced via $(DEVICE_PATH)/Kconfig).
#

config RK3588_OPENAMP
    bool "Enable OpenAMP/rpmsg (MICA) support"
    default n
    depends on PLATFORM_RK3588_M
    select COMPONENT_OPENAMP
    help
      Bring up open-amp + libmetal on the RTOS side and register the
      rpmsg-tty endpoint for the Linux MICA framework (/dev/ttyRPMSG0).
      Interrupt notification uses SGI 7 (MICA convention).

config MCS
    bool "Enable MCS hybrid deployment (AMP slave alongside Linux master)"
    default n
    depends on PLATFORM_RK3588_M
    select RK3588_OPENAMP
    help
      MCS hybrid deployment: this core (CPU7, Cortex-A76) runs as the AMP
      slave started and stopped by the Linux master mcs_km driver, sharing
      the debug UART (Linux ttyFIQ0 console) with the master. When enabled:
        - UartInit keeps the shared UART untouched (polled TX only);
        - the shell does not poll UART RX (input comes over rpmsg tty);
        - the mica/rpmsg service task is created at boot.
      When disabled the board owns the UART itself (standalone bring-up).

config MCS_NET
    bool "Real-time NIC data plane on GMAC1 / ETH2 (slave side)"
    default n
    depends on MCS
    help
      Slave-side data plane for the real-time NIC endpoint: the Linux
      master mcs_net.ko gives up GMAC1 (fe1c0000, the ETH2 RJ45 behind
      a YT9214 switch) after bring-up (clocks, reset, pinmux + php_grf/
      sys_grf, PHY/MDIO) and this core runs the RX/TX rings against the
      frozen net.h contract (protocol-agnostic frame driver; any
      link-layer protocol is implemented on top). The GMAC1 interrupt
      (INTID 266 = GIC SPI 234 + 32) is owned by this core and
      registered via ArchHwiCreate. Rx/Tx mode (interrupt / polled /
      hybrid) is a runtime NetConfig option, not a build switch. The
      RGMII side runs fixed 1000M full duplex (the switch buffers
      between port speeds), so there is no forced-link policy. A user
      demo task (net_test.c) is compiled in: polled RX, sending
      numbered 0x88B5 test frames and printing statistics once a
      second.

config MCS_CAN
    bool "Real-time CAN data plane on CAN1/CAN2, classic + CAN-FD (slave side)"
    default n
    depends on MCS
    help
      Slave-side data plane for the real-time CAN endpoints: the Linux
      master mcs_can.ko gives up CAN1 (fea60000) and CAN2 (fea70000)
      after bring-up (baudclk retarget + clock hold, CRU resets,
      can1m1/can2m1 pinmux) and this core runs the tx/rx fifos against
      the can.h v2 contract (classic CAN 2.0B AND CAN-FD frames,
      protocol-agnostic). The CAN interrupts (INTID 374/375 = GIC SPI
      342/343 + 32) are owned by this core and registered via
      ArchHwiCreate. Rx/Tx mode, work mode (loopback/silent), bit rate
      (arbitration + FD data phase) are runtime CanConfig options, not
      build switches. A self-test task (can_test.c) is compiled in:
      loopback phases covering classic frames, FD frames (FDF/BRS, up
      to 64 bytes, data rates 2M/5M), acceptance filtering and both
      ports - zero external hardware required.
```

## targets/stm32f407vet6/liteos_m/Kconfig
```kconfig
menu "Box Config"

menu "dbx Config"

config DBX_TASK_LIMIT
    int "dbx task num"
    default 3

config DBX_EVENT_LIMIT
    int "dbx event num"
    default 3

config DBX_MUX_LIMIT
    int "dbx mux num"
    default 3

config DBX_QUEUE_LIMIT
    int "dbx queue num"
    default 3

config DBX_SEM_LIMIT
    int "dbx sem num"
    default 3

config DBX_SHM_LIMIT
    int "dbx shm num"
    default 0

config DBX_SWT_LIMIT
    int "dbx swt num"
    default 3

config DBX_COND_LIMIT
    int "dbx cond num"
    default 0

config DBX_MQUEUE_LIMIT
    int "dbx mqueue num"
    default 0

config DBX_SID_LIMIT
    int "dbx sid num"
    default 20

endmenu

menu "appBox Config"

config APPBOX_TASK_LIMIT
    int "appBox task num"
    default 10

config APPBOX_EVENT_LIMIT
    int "appBox event num"
    default 10

config APPBOX_MUX_LIMIT
    int "appBox mux num"
    default 10

config APPBOX_QUEUE_LIMIT
    int "appBox queue num"
    default 10

config APPBOX_SEM_LIMIT
    int "appBox sem num"
    default 10

config APPBOX_SHM_LIMIT
    int "appBox shm num"
    default 0

config APPBOX_SWT_LIMIT
    int "appBox swt num"
    default 10

config APPBOX_COND_LIMIT
    int "appBox cond num"
    default 4

config APPBOX_MQUEUE_LIMIT
    int "appBox mqueue num"
    default 10

config APPBOX_SID_LIMIT
    int "appBox sid num"
    default 100

endmenu

menu "thirdBox Config"

config THIRDBOX_TASK_LIMIT
    int "thirdBox task num"
    default 3

config THIRDBOX_EVENT_LIMIT
    int "thirdBox event num"
    default 3

config THIRDBOX_MUX_LIMIT
    int "thirdBox mux num"
    default 3

config THIRDBOX_QUEUE_LIMIT
    int "thirdBox queue num"
    default 3

config THIRDBOX_SEM_LIMIT
    int "thirdBox sem num"
    default 3

config THIRDBOX_SHM_LIMIT
    int "thirdBox shm num"
    default 0

config THIRDBOX_SWT_LIMIT
    int "thirdBox swt num"
    default 3

config THIRDBOX_COND_LIMIT
    int "thirdBox cond num"
    default 0

config THIRDBOX_MQUEUE_LIMIT
    int "thirdBox mqueue num"
    default 0

config THIRDBOX_SID_LIMIT
    int "thirdBox sid num"
    default 20

endmenu

endmenu
```
