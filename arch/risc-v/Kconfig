## arch/risc-v/Kconfig
```kconfig
# RISC-V Architecture
# Only LinxCore131 and LinxCore170 cores are adapted here.
# Note: config names omit the LOSCFG_ prefix; genconfig adds it automatically,
# so GN checks use defined(LOSCFG_ARCH_LINXCORE_131) etc.

config ARCH_RISCV_RV32IMC
    bool
    help
      32-bit RISCV RV32IMC base ISA.

config ARCH_RISCV_ISA_A
    bool
    help
      "A" Standard Extension for Atomic Instructions (lr.w/sc.w/amo*).
      Kernel atomics use these only when ARCH_RISCV_HW_ATOMIC is set.

config ARCH_RISCV_ISA_B0p92
    bool
    help
      "B" Standard Extension at version 0.92 for Bit Manipulation (draft).
      Consumed by the arch-level -march composition (arch/risc-v/src/BUILD.gn).
      Spelled "b0p92", never a bare "b": clang 15+ "b" means ratified B 1.0.

config ARCH_RISCV_ISA_B1p0
    bool
    help
      "B" Standard Extension 1.0 (ratified bit manipulation: andn/orn/xnor,
      clz/ctz/cpop, min/max, rol/ror, sha3add, rev8, orc.*). No in-tree
      core selects it; clang 15+ spells it as a bare "b" in -march.

config ARCH_RISCV_ISA_F
    bool
    help
      "F" Standard Extension for Single-Precision Floating-Point.

config ARCH_RISCV_ISA_D
    bool
    select ARCH_RISCV_ISA_F
    help
      "D" Standard Extension for Double-Precision Floating-Point.

config ARCH_RISCV_ISA_V
    bool
    help
      "V" Standard Extension for Vector Operations (LinxCore170 V-variant).
      Capability marker only: not composed into the kernel -march, the kernel
      does not use vector codegen (the vendor gates march "v" behind a
      separate VECTOR_ENABLE knob, absent here).

config LCMP_CUSTOM_INST16_EXTENSIONS
    bool
    help
      Extra custom 16-bit extension for RISC-V C-extension. Depends on ARCH_LINX_M.
      Includes arithmetic logic, byte/half-word sign/zero-extension, store-zero, push/pop.

config LCMP_CUSTOM_INST16_SUB_EXTENSIONS
    bool
    help
      Another custom 16-bit extension. Has encoding conflicts with standard C-extension.
      Cannot be enabled when C-extension and D-extension are both configured.

config LCMP_CUSTOM_INST32_EXTENSIONS
    bool
    help
      32-bit custom instructions for code size and performance optimization.
      Includes pre-shift ALU, immediate compare-branch, bit manipulation,
      load/store multiple, conditional move, half-precision FP convert,
      pre/post-index load/store, load/store pair, FP round-to-int,
      interrupt nest enable/disable, large-offset jump, gp-based load/store,
      multiply-add/sub, prefetch, stop-for-security.

config LCMP_CUSTOM_INST48_EXTENSIONS
    bool
    help
      48-bit custom extension that reduces cost of encoding large immediates, saving two bytes.

config ARCH_LINX_M
    bool
    select ARCH_RISCV_RV32IMC
    select ARCH_RISCV32
    select RISCV_LCMP_CLIC if !ARCH_INTERRUPT_VENDOR
    help
      General setup for LinxCore m-profile. Specific processor cores select this
      option directly.

# Supported Processor Cores

config ARCH_QEMU_RISCV32_VIRT
    bool
    select ARCH_RISCV_RV32IMC
    select ARCH_RISCV_ISA_A
    select ARCH_RISCV32
    help
      QEMU virt platform RISC-V 32-bit (rv32imac). Uses the standard
      RISC-V CLINT timer and memory-mapped PLIC. No custom instructions.

config ARCH_LINXCORE_131
    bool
    select ARCH_RISCV_RV32IMC
    select ARCH_RISCV_ISA_F
    select ARCH_RISCV32
    select RISCV_HIMIDEERV200_PLIC if !ARCH_INTERRUPT_VENDOR
    help
      HiSilicon LinxCore131. Single-precision FPU (rv32imfc).
      Does not belong to LinxCore m-profile, so does not select ARCH_LINX_M.

config ARCH_LINXCORE_170
    bool
    select ARCH_LINX_M
    select ARCH_RISCV_ISA_F
    help
      HiSilicon LinxCore170 (LinxCore m-profile, rv32imfc floor). Config
      variants CONFIG61/41/32/60 select this and add their ISA/segment set.

config ARCH_RISCV_EPMP
    bool
    help
      RISC-V PMP enhancements extension.

config ARCH_RISCV_TES
    bool
    select ARCH_RISCV_EPMP
    help
      RISC-V Trusted Execution State Extension.

config ARCH_RISCV_INT_AUTO_STACK
    bool
    help
      RISC-V interrupt hardware stacking.

# ---------------------------------------------------------------------------
# Reset vector provider
# ---------------------------------------------------------------------------
config USING_BOARD_RESET_VECTOR
    bool "Board provides its own reset_vector.S and stack layout"
    default y
    help
      When set, the board supplies its own reset_vector.S and linker-defined
      stack symbols; the arch-level los_reset_vector.S / los_stack.S are
      excluded to avoid duplication. Clear for a bare board.

# ---------------------------------------------------------------------------
# System stack sizes (arch-specific; preset defaults for TINY/SMALL/STANDARD).
# Consumed by los_stack.S (when USING_BOARD_RESET_VECTOR is off) and by
# config.gni -defsym injection into board.ld (WS63).
# ---------------------------------------------------------------------------
config IRQ_STACK_SIZE
    int "IRQ stack size in bytes"
    default 512 if KERNEL_RAM_PRESET_TINY
    default 512 if KERNEL_RAM_PRESET_SMALL
    default 1024 if KERNEL_RAM_PRESET_STANDARD
    default 2048

config STARTUP_STACK_SIZE
    int "Startup stack size in bytes (0 = reuse IRQ stack)"
    default 2048

config EXC_STACK_SIZE
    int "Exception stack size in bytes (0 = reuse startup stack)"
    default 0 if KERNEL_RAM_PRESET_TINY
    default 0 if KERNEL_RAM_PRESET_SMALL
    default 512 if KERNEL_RAM_PRESET_STANDARD
    default 1024

config NMI_STACK_SIZE
    int "NMI stack size in bytes (0 = reuse exc stack)"
    default 0 if KERNEL_RAM_PRESET_TINY
    default 0 if KERNEL_RAM_PRESET_SMALL
    default 0 if KERNEL_RAM_PRESET_STANDARD
    default 1024

# LinxCore170 configuration variants

config ARCH_LINXCORE_170_CONFIG61
    bool
    select ARCH_LINXCORE_170
    select ARCH_RISCV_ISA_B0p92
    select ARCH_RISCV_ISA_D
    select LCMP_CUSTOM_INST16_EXTENSIONS
    select LCMP_CUSTOM_INST32_EXTENSIONS
    select ARCH_RISCV_TES

config ARCH_LINXCORE_170_CONFIG41
    bool
    select ARCH_LINXCORE_170
    select ARCH_RISCV_ISA_B0p92
    select ARCH_RISCV_ISA_D
    select LCMP_CUSTOM_INST16_EXTENSIONS
    select LCMP_CUSTOM_INST32_EXTENSIONS

config ARCH_LINXCORE_170_CONFIG32
    bool
    select ARCH_LINXCORE_170
    select ARCH_RISCV_ISA_B0p92
    select ARCH_RISCV_ISA_F
    select LCMP_CUSTOM_INST16_EXTENSIONS
    select LCMP_CUSTOM_INST32_EXTENSIONS

config ARCH_LINXCORE_170_CONFIG60
    bool
    select ARCH_LINXCORE_170
    select ARCH_RISCV_ISA_B0p92
    select ARCH_RISCV_ISA_D
    select ARCH_RISCV_ISA_V
    select LCMP_CUSTOM_INST16_EXTENSIONS
    select LCMP_CUSTOM_INST32_EXTENSIONS
    select ARCH_RISCV_EPMP
```

## kernel/extended/signal/Kconfig
```kconfig
config KERNEL_SIGNAL
    bool "Enable Signal"
    default n if KERNEL_RAM_PRESET_TINY || KERNEL_RAM_PRESET_SMALL
    default y
    depends on KERNEL_EXTKERNEL && ARCH_ARM_CORTEX_M
    depends on !BOX
    help
      Select y to build LiteOS with signal.

      Mutually exclusive with BOX. The signal-context restore path in the
      dispatch asm jumps straight to SignalContextRestore, past the
      BOX_PENDSV_RESTORE hook that maintains the per-task box state - so a
      signal-delivered task would resume with g_curBoxId, the MPU box regions
      (R3/R4), g_boxLocalPool and CONTROL/g_sysMode all still describing the
      PREVIOUS task. That is a silent isolation break rather than a crash: the
      task runs its own code under another box's memory map, and no fault
      reports it. Supporting signals under BOX needs that path to re-establish
      box state first; until then the combination is rejected here rather than
      left to fail quietly. The los_box_dispatch.h #error is the backstop for
      configs that bypass Kconfig.
```

## shell/Kconfig
```kconfig
config SHELL
    bool "Enable Shell"
    default n if KERNEL_RAM_PRESET_TINY
    default n if KERNEL_RAM_PRESET_SMALL
    default n if KERNEL_RAM_PRESET_STANDARD
    default n
    depends on DEBUG_VERSION
    select USE_SHELL
    help
      Answer Y to enable LiteOS support shell cmd.

config USE_SHELL
    bool
    default n

menu "Functionality of Shell"
    depends on SHELL

config SHELL_PRIO
    int "Shell Task Priority"
    default 3
    range 1 31
    depends on SHELL

config SHELL_STACK_SIZE
    int "Shell Task Stack Size"
    default 4096
    depends on SHELL
    help
      Set a proper shell stack size.

config SHELL_ENTRY_STACK_SIZE
    int "Shell Entry Task Stack Size"
    default 4096
    depends on SHELL
    help
      Set a proper shell entry task stack size.

config SHELL_LK
    bool "Enable Shell LK (Logger)"
    default y
    depends on SHELL
    help
      Answer Y to enable LiteOS shell LK (logger) subsystem. When enabled,
      LOS_LkPrint / LOS_LkRegHook are available and the kernel printf path
      routes through the LK hook for level-based filtering. The default trace
      level is LOS_ERR_LEVEL (2). See shell_lk.h for the public API.

config SHELL_DMESG
    bool "Enable Shell Dmesg"
    default n
    depends on SHELL
    help
      Answer Y to enable LiteOS shell dmesg subsystem. When enabled, an 8KB
      ring buffer captures kernel log output and the LOS_Dmesg* public API
      becomes available. The kernel printf path (los_printf.c UartOutput)
      automatically records into the dmesg buffer via OsLogMemcpyRecord.
      See dmesg.h for the public API.

config ENABLE_MAGICKEY
    bool "Enable Magic Key"
    default n
    depends on SHELL
    help
      Answer Y to enable LiteOS shell magic key.
        ctrl+r Magic key check switch;
        ctrl+z Show all magic op key;
        ctrl+t Show task information;
        ctrl+p System panic;
        ctrl+e Check system memory pool.

config CMD_UNLOAD
    bool "Enable Command Unload Function"
    default n
    depends on SHELL
    help
      Enable the command unload function.

endmenu
```
